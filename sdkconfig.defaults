## sdkconfig.defaults
```kconfig
# Increase default FreeRTOS tick rate to 1000 Hz for smoother LVGL animations
CONFIG_FREERTOS_HZ=1000

# LVGL Memory Configuration (per user rules for LVGL 9)
CONFIG_LV_USE_CLIB_MALLOC=y
CONFIG_LV_USE_BUILTIN_MALLOC=n

# Depending on exact CYD board, 4MB or 16MB flash, setting 4MB as minimum safe default
CONFIG_ESPTOOLPY_FLASHSIZE_4MB=y

# Set optimization level
CONFIG_COMPILER_OPTIMIZATION_PERF=y

CONFIG_PARTITION_TABLE_CUSTOM=y
CONFIG_PARTITION_TABLE_CUSTOM_FILENAME="partitions.csv"
CONFIG_PARTITION_TABLE_FILENAME="partitions.csv"

# Enable larger LVGL fonts for the clock
CONFIG_LV_FONT_MONTSERRAT_48=y
CONFIG_LV_FONT_MONTSERRAT_24=y

CONFIG_LV_USE_FS_STDIO=y
CONFIG_LV_FS_STDIO_LETTER=65
CONFIG_LV_FS_STDIO_PATH=""
CONFIG_LV_USE_TJPGD=y
CONFIG_LV_USE_LODEPNG=y
CONFIG_FATFS_LFN_HEAP=y
```
